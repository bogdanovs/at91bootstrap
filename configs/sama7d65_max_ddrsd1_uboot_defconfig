## configs/sama7d65_max_ddrsd1_uboot_defconfig
```kconfig
# Copyright (C) 2025 Microchip Technology Inc. and its subsidiaries
#
# SPDX-License-Identifier: MIT

CONFIG_SAMA7D65=y
CONFIG_CPU_CLK_800MHZ=y
CONFIG_CONSOLE_INDEX=19
CONFIG_DEBUG=y
CONFIG_DDR_SET_BY_DEVICE=y
CONFIG_DDR_IS43TR81024BL_125KBLI=y
CONFIG_DDR_16_GBIT=y
CONFIG_DDR_DRIVER_IMPEDANCE=40
CONFIG_DDR_ODT_IMPEDANCE=120
CONFIG_MEM_CLOCK_533=y
CONFIG_SDCARD=y
CONFIG_SDHC1=y
# CONFIG_REDIRECT_ALL_INTS_AIC is not set
CONFIG_TZC400=y
CONFIG_JUMP_ADDR="0x66f00000"
CONFIG_LED_ON_BOARD=y
CONFIG_LED_R_ON_PIOB=y
CONFIG_LED_R_PIN=17
CONFIG_LED_G_ON_PIOB=y
CONFIG_LED_G_PIN=15
CONFIG_LED_B_ON_PIOA=y
CONFIG_LED_B_PIN=21
CONFIG_FLEXCOM10=y
CONFIG_MCP16502=y
CONFIG_MCP16502_SET_VOLTAGE=y
CONFIG_VOLTAGE_OUT4=1150
CONFIG_WDTS=y
```
